## CMakeLists.txt
```
# SPDX-License-Identifier: Apache-2.0

cmake_minimum_required(VERSION 3.20.0)
find_package(Zephyr REQUIRED HINTS $ENV{ZEPHYR_BASE})
project(test_zephyr)

target_sources(app PRIVATE  src/main.c
                            src/interface.c
                            src/uart.c
                            src/sensors.c
                            src/temperature.c
)
```

## prj.conf
```kconfig
CONFIG_UART_CONSOLE=y
CONFIG_UART_INTERRUPT_DRIVEN=y
CONFIG_THREAD_STACK_INFO=y
CONFIG_LOG=y
CONFIG_LOG_DEFAULT_LEVEL=3
CONFIG_RING_BUFFER=y
```

## src/main.c
```c
#include <stdio.h>
#include <zephyr/kernel.h>
#include <zephyr/logging/log.h>

#include "interface.h"
#include "sensors.h"

LOG_MODULE_REGISTER(logger, LOG_LEVEL_INF);

#define STACK_SIZE  2048U
#define PRIORITY    7

#define DEFAULT_SENSORS_QTY 10

#define CMD_QUEUE_SIZE   16
#define DATA_QUEUE_SIZE  256

K_MSGQ_DEFINE(sensors_cmd_queue, sizeof(sensor_cmd_t), CMD_QUEUE_SIZE, 4);
K_MSGQ_DEFINE(sensors_data_queue, sizeof(uint8_t), DATA_QUEUE_SIZE, 4);

static void interface_thread(void)
{
    interface_init(&sensors_cmd_queue, &sensors_data_queue);

    for(;;)
    {
        interface_parse_task();
        interface_transmit_task();
        LOG_DBG("Interface thread!");
        k_sleep(K_MSEC(1));
    }

}

static void sensors_thread(void)
{
	sensors_init(DEFAULT_SENSORS_QTY, &sensors_cmd_queue, &sensors_data_queue);

    for(;;)
    {
        sensors_data_update_task();
        sensors_handle_cmd_task();
        LOG_DBG("Sensors thread");
        k_sleep(K_MSEC(1));
    }
}

int main(void)
{
    LOG_INF("Program started!");
	return 0;
}

K_THREAD_DEFINE(interface_thread_id, STACK_SIZE, interface_thread, NULL, NULL, NULL,
		PRIORITY, 0, 0);
K_THREAD_DEFINE(sensors_thread_id, STACK_SIZE, sensors_thread, NULL, NULL, NULL,
		PRIORITY, 0, 0);
```

## src/interface.c
```c
#include "interface.h"
#include <zephyr/kernel.h>
#include <zephyr/logging/log.h>

#include "uart.h"
#include "sensors.h"

LOG_MODULE_DECLARE(logger);

#define CMD_LAST_SYMBOL    '\n'

static struct k_msgq * sensors_cmd_queue = NULL;
static struct k_msgq * sensors_data_queue = NULL;

static const char *read_cmd_preamble = "read";
static const char *toggle_cmd_preamble = "toggle";
static const char *quantity_cmd_preamble = "quantity ";
static const char *period_cmd_preamble = "period ";

struct command_parser {

    char buffer[16];
    uint8_t counter;

    sensor_cmd_t cmd;
};

static struct command_parser cmd_parser = {
    .buffer = {0},
    .counter = 0,
    .cmd = {
        .idx = 0,
        .period = 0,
        .cmd_type = CMD_UNDEF
    }
};

static void interface_reset_parser(void)
{
    memset((void*)cmd_parser.buffer, 0, sizeof(cmd_parser.buffer));
    cmd_parser.cmd.idx = 0;
    cmd_parser.cmd.period = 0;
    cmd_parser.cmd.cmd_type = CMD_UNDEF;
    cmd_parser.counter = 0;
}

void interface_parse_task(void)
{
    while(uart_is_rx_data())
    {
        uint8_t rx_byte = uart_get_byte();

        if(rx_byte == CMD_LAST_SYMBOL)
        {
            if(strncmp(cmd_parser.buffer, read_cmd_preamble, strlen(read_cmd_preamble)) == 0)
            {
                cmd_parser.cmd.cmd_type = CMD_READ;
            }
            else
            if(strncmp(cmd_parser.buffer, toggle_cmd_preamble, strlen(toggle_cmd_preamble)) == 0)
            {
                cmd_parser.cmd.cmd_type = CMD_TOGGLE;
            }
            else
            if(strncmp(cmd_parser.buffer, quantity_cmd_preamble, strlen(quantity_cmd_preamble)) == 0)
            {
                char *cmd_args = &cmd_parser.buffer[strlen(quantity_cmd_preamble)];
                char *endptr = NULL;
                cmd_parser.cmd.idx = strtol(cmd_args, &endptr, 10);
                cmd_parser.cmd.cmd_type = CMD_QUANTITY;
            }
            else
            if(strncmp(cmd_parser.buffer, period_cmd_preamble, strlen(period_cmd_preamble)) == 0)
            {
                char *cmd_args = &cmd_parser.buffer[strlen(period_cmd_preamble)];
                char *endptr = NULL;
                cmd_parser.cmd.idx = strtoul(cmd_args, &endptr, 10);

                if (*endptr == ' ')
                {
                    cmd_args = endptr + 1;
                    cmd_parser.cmd.period = strtoul(cmd_args, NULL, 10);
                }
                else
                    LOG_WRN("Invalid period!");

                cmd_parser.cmd.cmd_type = CMD_PERIOD;
            }
            else
            {
                LOG_WRN("Wrong cmd!");
                interface_reset_parser();
                return;
            }

            if (k_msgq_put(sensors_cmd_queue, &cmd_parser.cmd, K_NO_WAIT) != 0)
                LOG_ERR("Failed to put cmd in queue!");

            interface_reset_parser();
        }
        else if(cmd_parser.counter < sizeof(cmd_parser.buffer) - 1)
        {
            cmd_parser.buffer[cmd_parser.counter++] = rx_byte;
        }
        else
        {
            LOG_WRN("Command buffer overflow!");
            interface_reset_parser();
        }

    }
}

void interface_transmit_task(void)
{
    uint8_t tx_byte = 0;
    while(k_msgq_get(sensors_data_queue, &tx_byte, K_NO_WAIT) == 0)
        uart_send_byte(tx_byte);
}

void interface_init(struct k_msgq * sensors_cmd_msgq, struct k_msgq * sensors_data_msgq)
{
    uart_init();

    sensors_cmd_queue = sensors_cmd_msgq;
    sensors_data_queue = sensors_data_msgq;
}
```

## src/interface.h
```c
#ifndef __INTERFACE_H_
#define __INTERFACE_H_

#include <stdint.h>
#include <stdlib.h>
#include <stdbool.h>
#include <string.h>
#include <zephyr/kernel.h>

typedef enum {
    CMD_UNDEF,      // NO_CMD
    CMD_READ,       // read sensors data "read\n"
    CMD_TOGGLE,     // switch data type "toggle\n"
    CMD_QUANTITY,   // change sensors quantity (up to 256) "quantity <q>\n", q - quantity
    CMD_PERIOD      // update sensor's period  "period <n> <p>\n" n - sensor, p - period
} cmd_t;

typedef struct sensor_cmd {
    cmd_t cmd_type;
    uint16_t idx;        // quantity of idx for period changing
    uint16_t period;
} sensor_cmd_t;

void interface_init(struct k_msgq * sensors_cmd_msgq, struct k_msgq * sensors_data_msgq);
void interface_parse_task(void);
void interface_transmit_task(void);

#endif /* __INTERFACE_H_ */
```

## src/ring_buffer.c
```c
/*
 * -----------------------------------------------------------------------------
 * Project       : ring_buffer
 * File          : ring_buffer.c
 * Author        : nktsb
 * Created on    : 12.03.2024
 * GitHub        : https://github.com/nktsb/ring_buffer
 * -----------------------------------------------------------------------------
 * Copyright (c) 2024 nktsb
 * All rights reserved.
 * -----------------------------------------------------------------------------
 */

#include "ring_buffer.h"

ring_buffer_st * ringBufferInit(size_t element_size, unsigned length)
{
	ring_buffer_st *buffer = malloc(sizeof(ring_buffer_st));
	if(buffer == NULL) return NULL;

	memset((void*)buffer, 0, sizeof(ring_buffer_st));

	buffer->data = malloc(length * element_size);
	if(buffer->data == NULL)
	{
		free(buffer);
		return NULL;
	}

	memset((void*)buffer->data, 0, length * element_size);

	buffer->length = length;
	buffer->element_size = element_size;
  	ringBufferClear(buffer);

	return buffer;
}

ring_buff_err_t ringBufferDeinit(ring_buffer_st *buffer)
{
	if(buffer == NULL) return ERR_RING_BUFF_NULL;

	ringBufferClear(buffer);
	free(buffer->data);
	free(buffer);

	return RING_BUFF_OK;
}

ring_buff_err_t ringBufferClear(ring_buffer_st* buffer)
{
	if(buffer == NULL) return ERR_RING_BUFF_NULL;

	buffer->input = 0;
	buffer->output = 0;

	return RING_BUFF_OK;
}

int ringBufferGetAvail(ring_buffer_st *buffer)
{
	if(buffer == NULL) return -1;

	return (buffer->input >= buffer->output)? 
			buffer->input - buffer->output : ((buffer->length - buffer->output) + buffer->input);
}

ring_buff_err_t ringBufferPutSymbol(ring_buffer_st* buffer, void *data)
{
	if(buffer == NULL) return ERR_RING_BUFF_NULL;
	if(buffer->length == ringBufferGetAvail(buffer)) return ERR_RING_BUFF_FULL;

	void *last_data_ptr = (uint8_t*)buffer->data + (buffer->input * buffer->element_size); 
	memcpy(last_data_ptr, data, buffer->element_size);

	buffer->input += 1;
	buffer->input %= buffer->length;

	return RING_BUFF_OK;
}

ring_buff_err_t ringBufferPutData(ring_buffer_st *buffer, void *data, unsigned data_len)
{
	if(buffer == NULL) return ERR_RING_BUFF_NULL;
	if((buffer->length - ringBufferGetAvail(buffer)) < data_len) return ERR_RING_BUFF_FULL;

	while(data_len)
	{
		unsigned round_max_len = (buffer->length - buffer->input);
		unsigned round_len = (data_len > round_max_len)? round_max_len: data_len;
		
		memcpy((void*)((uint8_t*)buffer->data + (buffer->input * buffer->element_size)), (void*)data, (round_len * buffer->element_size));
		data = (uint8_t*)data + (round_len * buffer->element_size);
		data_len -= round_len;

		buffer->input += round_len;
		buffer->input %= buffer->length;
	}
	return RING_BUFF_OK;
}

ring_buff_err_t ringBufferGetSymbol(ring_buffer_st* buffer, void *data)
{
	if(buffer == NULL) return ERR_RING_BUFF_NULL;
	if(ringBufferGetAvail(buffer) == 0) return ERR_RING_BUFF_EMPTY;

	void *last_data_ptr = (uint8_t*)buffer->data + (buffer->output * buffer->element_size); 
	memcpy(data, last_data_ptr, buffer->element_size);

	buffer->output += 1;
	buffer->output %= buffer->length;

	return RING_BUFF_OK;
}

ring_buff_err_t ringBufferGetData(ring_buffer_st *buffer, void *data, unsigned data_len)
{
	if (buffer == NULL) return ERR_RING_BUFF_NULL;
	if(ringBufferGetAvail(buffer) < data_len) return ERR_RING_BUFF_EMPTY;

	while(data_len)
	{
		unsigned round_max_len = (buffer->length - buffer->output);
		unsigned round_len = (data_len > round_max_len)? round_max_len: data_len;
		
		memcpy((void*)data, (void*)((uint8_t*)buffer->data + (buffer->output * buffer->element_size)), (round_len * buffer->element_size));
		data = (uint8_t*)data + (round_len * buffer->element_size);
		data_len -= round_len;

		buffer->output += round_len;
		buffer->output %= buffer->length;
	}
	return RING_BUFF_OK;
}
```

## src/ring_buffer.h
```c
/*
 * -----------------------------------------------------------------------------
 * Project       : ring_buffer
 * File          : ring_buffer.h
 * Author        : nktsb
 * Created on    : 12.03.2024
 * GitHub        : https://github.com/nktsb/ring_buffer
 * -----------------------------------------------------------------------------
 * Copyright (c) 2024 nktsb
 * All rights reserved.
 * -----------------------------------------------------------------------------
 */

#ifndef RING_BUFFER_H_
#define RING_BUFFER_H_

#include <stdint.h>
#include <stdlib.h>
#include <string.h>

#ifdef __cplusplus
    extern "C" {
#endif

// Structure representing the ring buffer
typedef struct
{
    unsigned length;       // Total length of the buffer
    unsigned input;        // Index for the next input position
    unsigned output;       // Index for the next output position
    void *data;           // Pointer to the buffer data
    size_t element_size;  // Size of each element in the buffer (in bytes)
} ring_buffer_st;

// Enumeration for ring buffer error codes
typedef enum {
    ERR_RING_BUFF_NULL = -3, // Error: buffer is NULL
    ERR_RING_BUFF_EMPTY,      // Error: buffer is empty
    ERR_RING_BUFF_FULL,       // Error: buffer is full
    RING_BUFF_OK              // Operation successful
} ring_buff_err_t;

/**
 * @brief Initializes a ring buffer.
 *
 * @param element_size Size of each element in the buffer (in bytes).
 * @param length Total number of elements the buffer can hold.
 * @return Pointer to the initialized ring buffer, or NULL on failure.
 */
ring_buffer_st * ringBufferInit(size_t element_size, unsigned length);

/**
 * @brief Deinitializes the ring buffer and frees allocated memory.
 *
 * @param buffer Pointer to the ring buffer to deinitialize.
 * @return Error code indicating the result of the operation.
 */
ring_buff_err_t ringBufferDeinit(ring_buffer_st *buffer);

/**
 * @brief Adds a single element to the ring buffer.
 *
 * @param buffer Pointer to the ring buffer.
 * @param data Pointer to the data to be added.
 * @return Error code indicating the result of the operation.
 */
ring_buff_err_t ringBufferPutSymbol(ring_buffer_st* buffer, void *data);

/**
 * @brief Retrieves a single element from the ring buffer.
 *
 * @param buffer Pointer to the ring buffer.
 * @param data Pointer to the location where the retrieved data will be stored.
 * @return Error code indicating the result of the operation.
 */
ring_buff_err_t ringBufferGetSymbol(ring_buffer_st* buffer, void *data);

/**
 * @brief Adds multiple elements to the ring buffer.
 *
 * @param buffer Pointer to the ring buffer.
 * @param data Pointer to the data to be added.
 * @param data_len Number of elements to add.
 * @return Error code indicating the result of the operation.
 */
ring_buff_err_t ringBufferPutData(ring_buffer_st *buffer, void *data, unsigned data_len);

/**
 * @brief Retrieves multiple elements from the ring buffer.
 *
 * @param buffer Pointer to the ring buffer.
 * @param data Pointer to the location where the retrieved data will be stored.
 * @param data_len Number of elements to retrieve.
 * @return Error code indicating the result of the operation.
 */
ring_buff_err_t ringBufferGetData(ring_buffer_st *buffer, void *data, unsigned data_len);

/**
 * @brief Gets the number of available elements in the ring buffer.
 *
 * @param buffer Pointer to the ring buffer.
 * @return Number of available elements.
 */
int ringBufferGetAvail(ring_buffer_st *buffer);

/**
 * @brief Clears the ring buffer, resetting input and output indices.
 *
 * @param buffer Pointer to the ring buffer.
 * @return Error code indicating the result of the operation.
 */
ring_buff_err_t ringBufferClear(ring_buffer_st *buffer);

#ifdef __cplusplus
    }
#endif

#endif /* RING_BUFFER_H_ */
```

## src/sensors.c
```c
#include "sensors.h"
#include <zephyr/kernel.h>
#include <zephyr/sys/printk.h>
#include <zephyr/logging/log.h>

#include "temperature.h"
#include "interface.h"

LOG_MODULE_DECLARE(logger);

#define SENSORS_MAX_QTY     256
#define SENSORS_MIN_PER_MS  100
#define SENSORS_MAX_PER_MS  2000

#define SENSORS_DEF_PER_MS  2000

typedef enum {
    FORMAT_STRING,
    FORMAT_BINARY,

    FORMATS_QTY
} data_format_t;

typedef struct sensor {

    int64_t last_read_stamp_ms;
    uint16_t period_ms;
    int16_t last_value;

    int16_t (*get_val_func)();

} sensor_st;

typedef struct sensors_arr {
    sensor_st *sensors;
    uint16_t quantity;
    data_format_t data_format;
    uint16_t min_period_ms;
} sensors_arr_st;

static int16_t (*def_get_val_func)() = temp_sensor_read;

static const char *sensor_pckt_preamble = "SENS";

static struct k_msgq * sensors_cmd_queue = NULL;
static struct k_msgq * sensors_data_queue = NULL;

static sensors_arr_st sensors_array = {
    .sensors = NULL,
    .quantity = 0,
    .data_format = FORMAT_STRING,
    .min_period_ms = SENSORS_MAX_PER_MS
};


static inline void sensors_array_init(uint16_t quantity, 
        int64_t def_timeout, int16_t (*get_val_func)() )
{
    sensors_array.quantity = quantity;
    sensors_array.sensors = calloc(quantity, sizeof(sensor_st));
    if(sensors_array.sensors == NULL)
    {
        LOG_ERR("Calloc failed: init sensors array");
        return;
    }
    int64_t current_time_ms = k_uptime_get();

    for(sensor_st *sensor = sensors_array.sensors; 
            sensor < (sensors_array.sensors + quantity); sensor++)
    {
        sensor->get_val_func = get_val_func;
        sensor->period_ms = def_timeout;
        sensor->last_value = 0;
        sensor->last_read_stamp_ms = current_time_ms;
    }
}

static void sensors_send_string_packet(void)
{
    for(uint16_t idx = 0; idx < sensors_array.quantity; idx++)
    {
        sensor_st *sensor = &sensors_array.sensors[idx];
        char buffer[64] = {0};
        snprintk(buffer, sizeof(buffer), "%s%d:%d\r\n", sensor_pckt_preamble, idx, sensor->last_value);
        for(char *symbol = buffer; symbol < buffer + strlen(buffer); symbol++)
            k_msgq_put(sensors_data_queue, symbol, K_FOREVER);
    }
}

static void sensors_send_bin_packet(void)
{
    for(sensor_st *sensor = sensors_array.sensors; 
            sensor < (sensors_array.sensors + sensors_array.quantity); sensor++)
    {
        int16_t sensor_data = sensor->last_value;
        k_msgq_put(sensors_data_queue, (uint8_t*)&sensor_data, K_FOREVER);
        k_msgq_put(sensors_data_queue, (uint8_t*)&sensor_data + 1, K_FOREVER);
    }
}

static void sensors_change_period(uint16_t sensor_idx, uint16_t period)
{
    if(sensor_idx >= sensors_array.quantity)
    {
        LOG_WRN("There is no sensor %d!", sensor_idx);
        return;
    }

    if(period < SENSORS_MIN_PER_MS) period = SENSORS_MIN_PER_MS;
    if(period > SENSORS_MAX_PER_MS) period = SENSORS_MAX_PER_MS;

    sensors_array.sensors[sensor_idx].period_ms = period;

    sensors_array.min_period_ms = SENSORS_MAX_PER_MS;
    for(sensor_st *sensor = sensors_array.sensors; 
            sensor < (sensors_array.sensors + sensors_array.quantity); sensor++)
    {
        if(sensor->period_ms < sensors_array.min_period_ms)
            sensors_array.min_period_ms = sensor->period_ms;
    }

    LOG_INF("Changed sensor %d period to %d ms\r\n", sensor_idx, period);
}

static void sensors_change_quantity(uint16_t new_qty)
{
    if(new_qty > SENSORS_MAX_QTY) new_qty = SENSORS_MAX_QTY;
    if(new_qty == sensors_array.quantity)
    {
        LOG_WRN("It's actual quantity!");
        return;
    }
    if(new_qty == 0)
    {
        LOG_WRN("Invalid quantity!");
        return;
    }

    sensor_st *new_sensors = calloc(new_qty, sizeof(sensor_st));
    if(new_sensors == NULL)
    {
        LOG_ERR("Calloc failed: updating sensors qty");
        return;
    }

    if(new_qty > sensors_array.quantity)
    {
        memcpy(new_sensors, sensors_array.sensors, (sensors_array.quantity * sizeof(sensor_st)));
        int64_t current_time_ms = k_uptime_get();
        for(sensor_st *sensor = &new_sensors[sensors_array.quantity]; 
                sensor < (&new_sensors[sensors_array.quantity] + new_qty); sensor++)
        {
            sensor->get_val_func = def_get_val_func;
            sensor->period_ms = SENSORS_DEF_PER_MS;
            sensor->last_value = 0;
            sensor->last_read_stamp_ms = current_time_ms;
        }
    }
    else
        memcpy(new_sensors, sensors_array.sensors, (new_qty * sizeof(sensor_st)));

    free(sensors_array.sensors);
    sensors_array.sensors = new_sensors;
    sensors_array.quantity = new_qty;

    LOG_INF("Changed sensor qty to %d\r\n", new_qty);
}

void sensors_init(uint16_t quantity, struct k_msgq * sensors_cmd_msgq, struct k_msgq * sensors_data_msgq)
{
    sensors_cmd_queue = sensors_cmd_msgq;
    sensors_data_queue = sensors_data_msgq;

    temp_sensor_init();
    sensors_array_init(quantity, SENSORS_DEF_PER_MS, def_get_val_func);
}

void sensors_data_update_task(void)
{
    int64_t current_time_ms = k_uptime_get();

    uint16_t sensor_idx = 0;
    for(sensor_st *sensor = sensors_array.sensors; 
            sensor < (sensors_array.sensors + sensors_array.quantity); sensor++)
    {
        if((current_time_ms - sensor->last_read_stamp_ms) >= sensor->period_ms)
        {
            sensor->last_value = sensor->get_val_func();
            sensor->last_read_stamp_ms = current_time_ms;
            LOG_INF("Sensor %d data updated: %d", sensor_idx, sensor->last_value);
        }
        sensor_idx++;
    }
    k_sleep(K_MSEC(sensors_array.min_period_ms / 2));
    k_cpu_idle();
}

void sensors_handle_cmd_task(void)
{
    sensor_cmd_t cmd_buff = {0};
    if (k_msgq_get(sensors_cmd_queue, &cmd_buff, K_NO_WAIT) == 0)
    {
        switch(cmd_buff.cmd_type)
        {
            case CMD_PERIOD:
                sensors_change_period(cmd_buff.idx, cmd_buff.period);
                break;
            case CMD_QUANTITY:
                sensors_change_quantity(cmd_buff.idx);
                break;
            case CMD_READ:
                switch(sensors_array.data_format)
                {
                    case FORMAT_STRING:
                        sensors_send_string_packet();
                        break;
                    case FORMAT_BINARY:
                        sensors_send_bin_packet();
                        break;
                    default:
                        break;
                }
                break;
            case CMD_TOGGLE:
                sensors_array.data_format++;
                sensors_array.data_format %= FORMATS_QTY;
                switch(sensors_array.data_format)
                {
                    case FORMAT_STRING:
                        LOG_INF("Format toggled to string!");
                        break;
                    case FORMAT_BINARY:
                        LOG_INF("Format toggled to bin!");
                        break;
                    default:
                        break;
                }
                break;
            default:
                break;
        }
    }
}
```

## src/sensors.h
```c
#ifndef __SENSORS_H_
#define __SENSORS_H_

#include <stdint.h>
#include <stdlib.h>
#include <string.h>
#include <zephyr/kernel.h>

void sensors_init(uint16_t quantity, struct k_msgq * sensors_cmd_msgq, struct k_msgq * sensors_data_msgq);
void sensors_data_update_task(void);
void sensors_handle_cmd_task(void);

#endif /* __SENSORS_H_ */
```

## src/temperature.c
```c
#include "temperature.h"
#include <zephyr/drivers/adc.h>
#include <zephyr/random/random.h>

static const uint16_t V25_mV = 1430;
static const float Avg_Slope = 4.3;

void temp_sensor_init(void)
{
#ifdef CONFIG_BOARD_NUCLEO_F103RB

    RCC->APB2ENR |= RCC_APB2ENR_ADC1EN;

    ADC1->SMPR1 |= ADC_SMPR1_SMP16;
    ADC1->CR2 |= ADC_CR2_EXTSEL | ADC_CR2_TSVREFE;
    ADC1->CR2 |= ADC_CR2_ADON;

    uint32_t timeout = 256;
    while(timeout--);

    ADC1->CR2 |= ADC_CR2_CAL;
    while (!(ADC1->CR2 & ADC_CR2_CAL));

#else   /* CONFIG_BOARD_NUCLEO_F103RB */
    srand(0);
#endif /* CONFIG_BOARD_NUCLEO_F103RB */
}

int16_t temp_sensor_read(void)
{
#ifdef CONFIG_BOARD_NUCLEO_F103RB

    ADC1->SQR3 = ADC_CHANNEL_16;
    ADC1->CR2 |= ADC_CR2_ADON;
    ADC1->CR2 |= ADC_CR2_SWSTART;
    while(!(ADC1->SR & ADC_SR_EOC));

    uint16_t adc_value_mV = ADC1->DR * 3300 / 4096;

    return ((V25_mV - adc_value_mV) / Avg_Slope) + 25;

#else /* CONFIG_BOARD_NUCLEO_F103RB */
    return (rand() % 35);
#endif /* CONFIG_BOARD_NUCLEO_F103RB */
}
```

## src/temperature.h
```c
#ifndef __TEMPERATURE_H_
#define __TEMPERATURE_H_

#include <stdint.h>
#include <stdlib.h>

void temp_sensor_init(void);
int16_t temp_sensor_read(void);

#endif /* __TEMPERATURE_H_ */
```

## src/uart.c
```c
#include "uart.h"
#include <zephyr/drivers/uart.h>
#include <zephyr/spinlock.h>
#include <zephyr/sys/ring_buffer.h>
#include <zephyr/devicetree.h>
#include <zephyr/logging/log.h>

LOG_MODULE_DECLARE(logger);

#define RX_BUFFER_SIZE     512
#define TX_BUFFER_SIZE     1024

static const struct device *uart_dev = DEVICE_DT_GET(DT_NODELABEL(usart2));

static struct ring_buf uart_rx_buffer = {0};
static uint8_t uart_rx_buffer_data[RX_BUFFER_SIZE] = {0};

static struct ring_buf uart_tx_buffer = {0};
static uint8_t uart_tx_buffer_data[TX_BUFFER_SIZE] = {0};

const struct uart_config uart_cfg = {
    .baudrate = 115200,
    .parity = UART_CFG_PARITY_NONE,
    .stop_bits = UART_CFG_STOP_BITS_1,
    .data_bits = UART_CFG_DATA_BITS_8,
    .flow_ctrl = UART_CFG_FLOW_CTRL_NONE
};

static void uart_cb(const struct device *dev, void *user_data)
{
	if(!uart_irq_update(dev)) return;

    if(uart_irq_rx_ready(dev))
    {
        uint8_t rx_byte = 0;
        uart_fifo_read(dev, &rx_byte, 1);
        ring_buf_put(&uart_rx_buffer, &rx_byte, 1);
    }
    if(uart_irq_tx_ready(dev))
    {
        uint8_t tx_byte = 0;
        if(ring_buf_get(&uart_tx_buffer, &tx_byte, 1) == 0)
            uart_irq_tx_disable(dev);
        else
            uart_fifo_fill(dev, &tx_byte, 1);
    }
    LOG_DBG("Uart callback\r\n");
}

void uart_init(void)
{
    uart_configure(uart_dev, &uart_cfg);

    if (!device_is_ready(uart_dev)) {
        LOG_ERR("Cannot find UART device!\n");
        return;
    }
    uart_irq_callback_set(uart_dev, uart_cb);

    ring_buf_init(&uart_rx_buffer, RX_BUFFER_SIZE, uart_rx_buffer_data);
    ring_buf_init(&uart_tx_buffer, TX_BUFFER_SIZE, uart_tx_buffer_data);

    uart_irq_rx_enable(uart_dev);
}

bool uart_is_rx_data(void)
{
    unsigned int key = irq_lock();
    bool res = !ring_buf_is_empty(&uart_rx_buffer);
    irq_unlock(key);
    return res;
}

uint8_t uart_get_byte(void)
{
    uint8_t rx_byte = 0;
    unsigned int key = irq_lock();
    ring_buf_get(&uart_rx_buffer, &rx_byte, 1);
    irq_unlock(key);
    return rx_byte;
}

void uart_send_byte(uint8_t byte)
{
    unsigned int key = irq_lock();
    ring_buf_put(&uart_tx_buffer, &byte, 1);
    irq_unlock(key);
    uart_irq_tx_enable(uart_dev);
    k_sleep(K_USEC(10));
}
```

## src/uart.h
```c
#ifndef __UART_H_
#define __UART_H_

#include <stdbool.h>
#include <stdint.h>

void uart_init(void);
bool uart_is_rx_data(void);
uint8_t uart_get_byte(void);
void uart_send_byte(uint8_t byte);

#endif /* __UART_H_ */
```
